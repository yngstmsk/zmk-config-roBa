## config/modules/roba-layer-status/Kconfig
```kconfig
config ZMK_LAYER_STATUS_BLE_HID
    bool "Layer status in keyboard report via BLE HID"
    default n
    depends on ZMK_BLE && (!ZMK_SPLIT || ZMK_SPLIT_ROLE_CENTRAL)
    help
      Embed the highest active layer index in the keyboard HID report
      reserved byte (byte 1). Used by the roBa keymap overlay app on Windows.
```

## config/west.yml
```yaml
manifest:
  remotes:
    - name: zmkfirmware
      url-base: https://github.com/zmkfirmware
    - name: kumamuk-git
      url-base: https://github.com/kumamuk-git
    - name: maatthc
      url-base: https://github.com/maatthc
  projects:
    - name: zmk
      remote: zmkfirmware
      revision: main
      import: app/west.yml
    - name: zmk-feature-appcompanion
      remote: maatthc
      revision: main
  self:
    path: config
```
